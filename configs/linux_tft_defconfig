## configs/linux_tft_defconfig
```kconfig
BR2_aarch64=y
BR2_cortex_a55=y
BR2_ARM_FPU_VFPV4=y
BR2_TOOLCHAIN_EXTERNAL=y
BR2_TOOLCHAIN_EXTERNAL_CUSTOM=y
BR2_TOOLCHAIN_EXTERNAL_DOWNLOAD=y
BR2_TOOLCHAIN_EXTERNAL_URL="file:///home/praxis/gitSource/LinuxTFT/toolchain/aarch64-praxis-linux-gnu_sdk-buildroot.tar.gz"
BR2_TOOLCHAIN_EXTERNAL_GCC_11=y
BR2_TOOLCHAIN_EXTERNAL_HEADERS_6_1=y
BR2_TOOLCHAIN_EXTERNAL_CUSTOM_GLIBC=y
# BR2_TOOLCHAIN_EXTERNAL_INET_RPC is not set
BR2_TOOLCHAIN_EXTERNAL_CXX=y
BR2_DL_DIR="$(TOPDIR)/../downloads"
BR2_PACKAGE_OVERRIDE_FILE="board/praxis/linux-tft/local.mk"
BR2_TARGET_GENERIC_HOSTNAME="praxis-linux-tft"
BR2_TARGET_GENERIC_ISSUE="Welcome to the Praxis-Automation Linux TFT board"
BR2_ROOTFS_DEVICE_CREATION_DYNAMIC_EUDEV=y
BR2_TARGET_GENERIC_ROOT_PASSWD="5255"
BR2_ROOTFS_OVERLAY="board/praxis/linux-tft/fs_overlay"
BR2_ROOTFS_POST_IMAGE_SCRIPT="board/praxis/linux-tft/post-image.sh"
BR2_LINUX_KERNEL=y
BR2_LINUX_KERNEL_CUSTOM_GIT=y
BR2_LINUX_KERNEL_CUSTOM_REPO_URL="https://github.com/khoinguyen90/linux.git"
BR2_LINUX_KERNEL_CUSTOM_REPO_VERSION="praxis"
BR2_LINUX_KERNEL_USE_CUSTOM_CONFIG=y
BR2_LINUX_KERNEL_CUSTOM_CONFIG_FILE="board/praxis/linux-tft/praxis_linux_tft_defconfig"
BR2_LINUX_KERNEL_CONFIG_FRAGMENT_FILES="board/praxis/linux-tft/linux.fragment"
BR2_LINUX_KERNEL_DTS_SUPPORT=y
BR2_LINUX_KERNEL_INTREE_DTS_NAME="rockchip/rk3568-praxis-tft"
BR2_LINUX_KERNEL_DTB_OVERLAY_SUPPORT=y
BR2_PACKAGE_LIBERATION=y
BR2_PACKAGE_MESA3D=y
BR2_PACKAGE_MESA3D_GALLIUM_DRIVER_PANFROST=y
BR2_PACKAGE_MESA3D_OPENGL_EGL=y
BR2_PACKAGE_MESA3D_OPENGL_ES=y
BR2_PACKAGE_WESTON=y
BR2_PACKAGE_WESTON_WAYLAND=y
BR2_PACKAGE_WESTON_DEMO_CLIENTS=y
#BR2_PACKAGE_ROCKCHIP_RKBIN=y
#BR2_PACKAGE_ROCKCHIP_RKBIN_TPL_FILENAME="/bin/rk35/rk3568_ddr_1056MHz_v1.18.bin"
#BR2_PACKAGE_ROCKCHIP_RKBIN_BL31_FILENAME="/bin/rk35/rk3568_bl31_v1.43.elf"
BR2_PACKAGE_OPENSSH=y
BR2_TARGET_ROOTFS_EXT2=y
BR2_TARGET_ROOTFS_EXT2_4=y
BR2_TARGET_ROOTFS_EXT2_SIZE="250M"
#BR2_TARGET_UBOOT=y
#BR2_TARGET_UBOOT_BUILD_SYSTEM_KCONFIG=y
#BR2_TARGET_UBOOT_CUSTOM_GIT=y
#BR2_TARGET_UBOOT_CUSTOM_REPO_URL="https://github.com/khoinguyen90/u-boot.git"
#BR2_TARGET_UBOOT_CUSTOM_REPO_VERSION="praxis"
#BR2_TARGET_UBOOT_BOARD_DEFCONFIG="rk3568"
#BR2_TARGET_UBOOT_NEEDS_ROCKCHIP_RKBIN=y
#BR2_TARGET_UBOOT_SPL=y
BR2_PACKAGE_HOST_DOSFSTOOLS=y
BR2_PACKAGE_HOST_DTC=y
BR2_PACKAGE_HOST_GENIMAGE=y
BR2_PACKAGE_HOST_MTOOLS=y
BR2_PACKAGE_HOST_UBOOT_TOOLS=y
BR2_PACKAGE_HOST_UBOOT_TOOLS_BOOT_SCRIPT=y
BR2_PACKAGE_HOST_UBOOT_TOOLS_BOOT_SCRIPT_SOURCE="board/praxis/linux-tft/boot.cmd"
```

## configs/toolchain_defconfig
```kconfig
BR2_aarch64=y
BR2_cortex_a55=y
BR2_TOOLCHAIN_BUILDROOT_VENDOR="praxis"
BR2_KERNEL_HEADERS_6_1=y
BR2_GCC_VERSION_11_X=y
BR2_TOOLCHAIN_BUILDROOT_CXX=y
BR2_INIT_NONE=y
BR2_SYSTEM_BIN_SH_NONE=y
# BR2_PACKAGE_BUSYBOX is not set
# BR2_TARGET_ROOTFS_TAR is not set
```
